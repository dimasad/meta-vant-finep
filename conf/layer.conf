## conf/layer.conf
```bitbake
# We have a conf directory, append to BBPATH
BBPATH .= ":${LAYERDIR}"

# We have a recipes directory, add to BBFILES
BBFILES += "${LAYERDIR}/recipes-*/*/*.bb \
	    ${LAYERDIR}/recipes-*/*/*.bbappend"

BBFILE_COLLECTIONS += "meta-vant-finep"
BBFILE_PATTERN_meta-vant-finep := "^${LAYERDIR}/"
BBFILE_PRIORITY_meta-vant-finep = "9"
```
